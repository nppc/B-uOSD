; * Author of B-uOSD is Pavel Palonen
; *
; * B-uOSD is free software: you can redistribute it and/or modify
; * it under the terms of the GNU General Public License as published by
; * the Free Software Foundation, either version 3 of the License, or
; * (at your option) any later version.
; *
; * B-uOSD is distributed WITHOUT ANY WARRANTY; without even the implied warranty of
; * MERCHANTABILITY or FITNESS FOR A PARTICULAR PURPOSE.  See the
; * GNU General Public License for more details.
; * this text shall be included in all
; * copies or substantial portions of the Software.
; *
; * See <http://www.gnu.org/licenses/>.

.EQU	SYM_HEIGHT 				= 10
 
symbols:

; 6bit wide font
;sym0:	.DB 0b00011110, \
;			0b00110011, \
;			0b00100001, \
;			0b00100001, \
;			0b00100001, \
;			0b00100001, \
;			0b00100001, \
;			0b00100001, \
;			0b00110011, \
;			0b00011110
;
;sym1:	.DB 0b00000100, \
;			0b00001100, \
;			0b00010100, \
;			0b00000100, \
;			0b00000100, \
;			0b00000100, \
;			0b00000100, \
;			0b00000100, \
;			0b00000100, \
;			0b00011111
;		
;sym2:	.DB 0b00011110, \
;			0b00110011, \
;			0b00100001, \
;			0b00000011, \
;			0b00000110, \
;			0b00001100, \
;			0b00011000, \
;			0b00110000, \
;			0b00100000, \
;			0b00111111
;
;sym3:	.DB 0b00011110, \
;			0b00110011, \
;			0b00000001, \
;			0b00000011, \
;			0b00001110, \
;			0b00000011, \
;			0b00000001, \
;			0b00000001, \
;			0b00110011, \
;			0b00011110
;
;sym4:	.DB 0b00000011, \
;			0b00000111, \
;			0b00001101, \
;			0b00011001, \
;			0b00110001, \
;			0b00100001, \
;			0b00111111, \
;			0b00000001, \
;			0b00000001, \
;			0b00000001
;
;sym5:	.DB 0b00111111, \
;			0b00100000, \
;			0b00100000, \
;			0b00111110, \
;			0b00000011, \
;			0b00000001, \
;			0b00000001, \
;			0b00000001, \
;			0b00110011, \
;			0b00011110
;
;sym6:	.DB 0b00011110, \
;			0b00110011, \
;			0b00100000, \
;			0b00100000, \
;			0b00111110, \
;			0b00110011, \
;			0b00100001, \
;			0b00100001, \
;			0b00110011, \
;			0b00011110
;
;sym7:	.DB 0b00111111, \
;			0b00100001, \
;			0b00000011, \
;			0b00000010, \
;			0b00000110, \
;			0b00000100, \
;			0b00001100, \
;			0b00001000, \
;			0b00001000, \
;			0b00001000
;
;sym8:	.DB 0b00011110, \
;			0b00110011, \
;			0b00100001, \
;			0b00110011, \
;			0b00011110, \
;			0b00110011, \
;			0b00100001, \
;			0b00100001, \
;			0b00110011, \
;			0b00011110
;
;sym9:	.DB 0b00011110, \
;			0b00110011, \
;			0b00100001, \
;			0b00100001, \
;			0b00110011, \
;			0b00011111, \
;			0b00000001, \
;			0b00000001, \
;			0b00000011, \
;			0b00011110

; 7bit wide font
;sym0:	.DB 0b00011100, \
;			0b00110110, \
;			0b01100011, \
;			0b01100011, \
;			0b01100011, \
;			0b01100011, \
;			0b01100011, \
;			0b01100011, \
;			0b00110110, \
;			0b00011100
;
;sym1:	.DB 0b00000100, \
;			0b00001100, \
;			0b00011100, \
;			0b00101100, \
;			0b00001100, \
;			0b00001100, \
;			0b00001100, \
;			0b00001100, \
;			0b00001100, \
;			0b00111111
;		
;sym2:	.DB 0b00111110, \
;			0b01110111, \
;			0b01100011, \
;			0b00000011, \
;			0b00000111, \
;			0b00001110, \
;			0b00011100, \
;			0b00111000, \
;			0b01110000, \
;			0b01111111
;
;sym3:	.DB 0b00111110, \
;			0b01110111, \
;			0b01100011, \
;			0b00000110, \
;			0b00001100, \
;			0b00000110, \
;			0b00000011, \
;			0b01100011, \
;			0b01110111, \
;			0b00111110
;
;sym4:	.DB 0b00000010, \
;			0b00000110, \
;			0b00001110, \
;			0b00011110, \
;			0b00110110, \
;			0b01100110, \
;			0b01111111, \
;			0b00000110, \
;			0b00000110, \
;			0b00000110
;
;sym5:	.DB 0b01111111, \
;			0b01100000, \
;			0b01100000, \
;			0b01111110, \
;			0b00000111, \
;			0b00000011, \
;			0b00000011, \
;			0b01100011, \
;			0b01110111, \
;			0b00111110
;
;sym6:	.DB 0b00111110, \
;			0b01110011, \
;			0b01100000, \
;			0b01100000, \
;			0b01111110, \
;			0b01110111, \
;			0b01100011, \
;			0b01100011, \
;			0b01110111, \
;			0b00111110
;
;sym7:	.DB 0b01111111, \
;			0b01100011, \
;			0b00000011, \
;			0b00000011, \
;			0b00000110, \
;			0b00001100, \
;			0b00011000, \
;			0b00011000, \
;			0b00011000, \
;			0b00011000
;
;sym8:	.DB 0b00111110, \
;			0b01110111, \
;			0b01100011, \
;			0b01110111, \
;			0b00111110, \
;			0b01110111, \
;			0b01100011, \
;			0b01100011, \
;			0b01110111, \
;			0b00111110
;
;sym9:	.DB 0b00111110, \
;			0b01110111, \
;			0b01100011, \
;			0b01110011, \
;			0b01110111, \
;			0b00111111, \
;			0b00000011, \
;			0b00000011, \
;			0b01100111, \
;			0b00111100

sym0:	.DB 0b01111111, \
			0b01111111, \
			0b01000001, \
			0b01000001, \
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			0b01111111, \
			0b01111111

sym1:	.DB 0b00001000, \
			0b00001000, \
			0b00001000, \
			0b00001000, \
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			0b00001000, \
			0b00001000
		
sym2:	.DB 0b01111111, \
			0b01111111, \
			0b00000001, \
			0b00000001, \
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			0b01111111, \
			0b01111111

sym3:	.DB 0b01111111, \
			0b01111111, \
			0b00000001, \
			0b00000001, \
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			0b01111111, \
			0b01111111

sym4:	.DB 0b01000001, \
			0b01000001, \
			0b01000001, \
			0b01000001, \
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			0b00000001, \
			0b00000001

sym5:	.DB 0b01111111, \
			0b01111111, \
			0b01000000, \
			0b01000000, \
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			0b01111111, \
			0b01111111

sym6:	.DB 0b01111111, \
			0b01111111, \
			0b01000000, \
			0b01000000, \
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			0b01111111, \
			0b01111111

sym7:	.DB 0b01111111, \
			0b01111111, \
			0b00000001, \
			0b00000001, \
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			0b00000001, \
			0b00000001

sym8:	.DB 0b01111111, \
			0b01111111, \
			0b01000001, \
			0b01000001, \
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			0b01111111, \
			0b01111111

sym9:	.DB 0b01111111, \
			0b01111111, \
			0b01000001, \
			0b01000001, \
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			0b01111111, \
			0b01111111
			
symCross:
		.DB 0b00001000, \
			0b00001000, \
			0b00111110, \
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			0b00001000, \
			0b00001000


#if defined(BITMAP_NONE)
symbitmap:	; if no bitmap needed, then just print a space
#endif
; use the rest of space symbol from dot symbol
symspc:	.DB 0b00000000, \
			0b00000000
			
symdot:	.DB 0b00000000, \
			0b00000000, \
			0b00000000, \
			0b00000000, \
			0b00000000, \
			0b00000000
symcoln:.DB	0b00000000, \
			0b00000000, \
			0b00000011, \
			0b00000011, \
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			0b00000011, \
			0b00000000

#if defined(BITMAP_COPTER)
symbitmap:
		.DB 0b01000010, \
			0b10100101, \
			0b10100101, \
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			0b10100101, \
			0b01000010
#endif

#if defined(BITMAP_GOOGLES)
symbitmap:
		.DB 0b00000000, \
			0b00000000, \
			0b11111111, \
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			0b00000000, \
			0b00000000
#endif

; Letters for printing Pilot Name
#if defined(SYM_A)
symA:	.DB 0b00001000, \
			0b00011100, \
			0b00110110, \
			0b01100011, \
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			0b01000001, \
			0b01000001
#endif
#if defined(SYM_B)
symB:	.DB 0b01111100, \
			0b01111110, \
			0b01000010, \
			0b01000110, \
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			0b01111111, \
			0b01111110
#endif
#if defined(SYM_C)
symC:	.DB 0b00111110, \
			0b01111111, \
			0b01000001, \
			0b01000000, \
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			0b01111111, \
			0b01111110
#endif
#if defined(SYM_D)
symD:	.DB 0b01111100, \
			0b01111110, \
			0b01000111, \
			0b01000011, \
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			0b01111110, \
			0b01111100
#endif
#if defined(SYM_E)
symE:	.DB 0b00111111, \
			0b01111111, \
			0b01000000, \
			0b01000000, \
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			0b01111111, \
			0b00111111
#endif
#if defined(SYM_F)
symF:	.DB 0b00111111, \
			0b01111111, \
			0b01000000, \
			0b01000000, \
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			0b01000000, \
			0b01000000
#endif
#if defined(SYM_G)
symG:	.DB 0b00111110, \
			0b01111111, \
			0b01000001, \
			0b01000000, \
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			0b01111111, \
			0b01111110
#endif
#if defined(SYM_H)
symH:	.DB 0b01000001, \
			0b01000001, \
			0b01000001, \
			0b01000001, \
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			0b01000001, \
			0b01000001
#endif
#if defined(SYM_I)
symI:	.DB 0b00011100, \
			0b00011100, \
			0b00001000, \
			0b00001000, \
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			0b00011100, \
			0b00011100
#endif
#if defined(SYM_J)
symJ:	.DB 0b00001111, \
			0b00001111, \
			0b00000001, \
			0b00000001, \
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			0b01111111, \
			0b00111110
#endif
#if defined(SYM_K)
symK:	.DB 0b01000011, \
			0b01000110, \
			0b01001100, \
			0b01011000, \
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			0b01000110, \
			0b01000011
#endif
#if defined(SYM_L)
symL:	.DB 0b01000000, \
			0b01000000, \
			0b01000000, \
			0b01000000, \
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			0b01111111, \
			0b00111111
#endif
#if defined(SYM_M)
symM:	.DB 0b01000001, \
			0b01100011, \
			0b01100011, \
			0b01110111, \
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			0b01000001, \
			0b01000001
#endif
#if defined(SYM_N)
symN:	.DB 0b01000001, \
			0b01100001, \
			0b01110001, \
			0b01011001, \
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			0b01000001, \
			0b01000001
#endif
#if defined(SYM_O)
symO:	.DB 0b00111110, \
			0b01111111, \
			0b01000001, \
			0b01000001, \
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			0b01111111, \
			0b01111110
#endif
#if defined(SYM_P)
symP:	.DB 0b01111110, \
			0b01111111, \
			0b01000001, \
			0b01000001, \
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			0b01000000, \
			0b01000000
#endif
#if defined(SYM_Q)
symQ:	.DB 0b00111110, \
			0b01111111, \
			0b01000001, \
			0b01000001, \
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			0b01111111, \
			0b01111110
#endif
#if defined(SYM_R)
symR:	.DB 0b01111110, \
			0b01111111, \
			0b01000001, \
			0b01000001, \
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			0b01000110, \
			0b01000011
#endif
#if defined(SYM_S)
symS:	.DB 0b00111110, \
			0b01111111, \
			0b01000001, \
			0b01000000, \
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			0b01111111, \
			0b00111110
#endif
#if defined(SYM_T)
symT:	.DB 0b01111111, \
			0b01111111, \
			0b00001000, \
			0b00001000, \
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			0b00001000, \
			0b00001000
#endif
#if defined(SYM_U)
symU:	.DB 0b01000001, \
			0b01000001, \
			0b01000001, \
			0b01000001, \
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			0b01111111, \
			0b01111110
#endif
#if defined(SYM_V)
symV:	.DB 0b01000001, \
			0b01000001, \
			0b01000001, \
			0b01000001, \
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			0b00011100, \
			0b00001000
#endif
#if defined(SYM_W)
symW:	.DB 0b01000001, \
			0b01000001, \
			0b01000001, \
			0b01000001, \
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			0b00100010, \
			0b00100010
#endif
#if defined(SYM_X)
symX:	.DB 0b01000001, \
			0b01000001, \
			0b01100011, \
			0b00110110, \
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			0b01000001, \
			0b01000001
#endif
#if defined(SYM_Y)
symY:	.DB 0b01000001, \
			0b01000001, \
			0b01000001, \
			0b01000001, \
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			0b01111111, \
			0b00111110
#endif
#if defined(SYM_Z)
symZ:	.DB 0b01111111, \
			0b01111111, \
			0b00000011, \
			0b00000110, \
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			0b01111111, \
			0b01111111
#endif
